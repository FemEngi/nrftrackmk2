## boards/arm/standard/Kconfig.board
```kconfig
# Copyright (c) 2024 Nordic Semiconductor ASA
# SPDX-License-Identifier: Apache-2.0

config BOARD_STANDARD
	bool "standard"
	depends on SOC_NRF52832_CIAA
```
